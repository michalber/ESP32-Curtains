## main/Kconfig.projbuild
```kconfig
# put here your custom config value
menu "ESP32 Curtain Configuration"
config ESP_WIFI_SSID
    string "WiFi SSID"
    default "myssid"
    help
	SSID (network name) for the example to connect to.

config ESP_WIFI_PASSWORD
    string "WiFi Password"
    default "mypassword"
    help
	WiFi password (WPA or WPA2) for the example to use.

config ESP_MOTOR_OUT_A
    int "GPIO Pin A to control motor"
    default 27

config ESP_MOTOR_OUT_B
    int "GPIO Pin B to control motor"
    default 26

config ESP_MOTOR_EN
    int "GPIO Pin B to control motor"
    default 14

choice EXAMPLE_PROV_TRANSPORT
    bool "Provisioning Transport"
    default EXAMPLE_PROV_TRANSPORT_BLE
    help
        Wi-Fi provisioning component offers both, SoftAP and BLE transports. Choose any one.

    config EXAMPLE_PROV_TRANSPORT_BLE
        bool "BLE"
        select BT_ENABLED
        depends on IDF_TARGET_ESP32
    config EXAMPLE_PROV_TRANSPORT_SOFTAP
        bool "Soft AP"
endchoice

config EXAMPLE_PROV_TRANSPORT
    int
    default 1 if EXAMPLE_PROV_TRANSPORT_BLE
    default 2 if EXAMPLE_PROV_TRANSPORT_SOFTAP

config BLYNK_TOKEN
    string "Blynk token"
	default "token"
	help
		Blynk access token

config BLYNK_SERVER
    string "Blynk server"
	default ""
	help
		Customize Blynk server address

		Syntax: domain:port
        
endmenu
```
